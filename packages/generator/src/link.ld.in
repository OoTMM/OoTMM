#include <combo/defs.h>

SECTIONS
{

  gComboCtxRead   = COMBO_CTX_ADDR_READ;
  gComboCtxWrite  = COMBO_CTX_ADDR_WRITE;

#ifdef GAME_OOT
# include "link_oot.in"
# include "link_assets_oot.ld"
#endif

#ifdef GAME_MM
# include "link_mm.in"
# include "link_assets_mm.ld"
#endif

/* Overlays and patch/export tables are runtime entry points, not dead code. */
#define OVL(name) \
  .name.text   :   ALIGN(16) { KEEP(SORT(*)(.name.text*)); } \
  .name.data   :   ALIGN(16) { KEEP(SORT(*)(.name.data*)); KEEP(SORT(*)(.name.bss*)); } \
  .name.rodata :   ALIGN(16) { KEEP(SORT(*)(.name.rodata*)); } \
  .name.bss    :   ALIGN(16) { } \
  .name.meta   :   { KEEP(SORT(*)(.name.meta*)); }

  . = PAYLOAD_RAM;
  .text : {
    SORT(*)(.text*);
    SORT(*)(.data*);
    SORT(*)(.rodata*);
    SORT(*)(.bss*);
  }

  __combo_payload_end = .;

  .MIPS.abiflags : {
    SORT(*)(.MIPS.abiflags*);
  }

  . = 0x80800000;

  .patch : { KEEP(SORT(*)(.patch)); }
  .symbols_addr : { KEEP(SORT(*)(.symbols_addr)); }
  .symbols_name : { KEEP(SORT(*)(.symbols_name)); }

  . = 0x80d00000;

  __OVERLAYS__


  /DISCARD/ : { *(.*); }
}
