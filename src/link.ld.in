#include <combo/defs.h>

SECTIONS
{

  gComboCtxRead   = COMBO_CTX_ADDR_READ;
  gComboCtxWrite  = COMBO_CTX_ADDR_WRITE;

#ifdef GAME_OOT
# include "link_oot.in"
#endif

#ifdef GAME_MM
# include "link_mm.in"
#endif

  OVERLAY 0x06000000 : AT(0x06000000) {
    .cobject.data: { *(.cobject.data) }
  }

  . = PAYLOAD_RAM;
  .text : {
    *(.text*);
    *(.data*);
    *(.rodata*);
    *(.bss*);
  }

  . = 0x80800000;
  .patch : {
    *(.patch);
  }
  /DISCARD/ : { *(.*); }
}
